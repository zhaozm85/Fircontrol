/**
  ******************************************************************************
  * proj    firmware startup project
  * file    NTC.c
  * ver     1.0
  * brief   This is a NTC file for all C files.
  ------------------------------------------------------------------------------
  * 2012.02 created by taoyu@bakai.com
  */ 

/* File Id -------------------------------------------------------------------*/
#define _NTC_C_ 0x53
#define FILE_No _NTC_C_

/* Includes ------------------------------------------------------------------*/
#include  "ntc.h"  /* mandotary */
#include  "mcu.h"

/* Private Macros & Defines --------------------------------------------------*/

#define   NTC_CURVE_MAX   3

#ifndef   TUNE_NTC
#define   TUNE_NTC    0
#endif

#if   TUNE_NTC
#define   NTC_PRINTF  PRINTF
#else
#define   NTC_PRINTF  empty_printf
#endif

/* Private typedefs ----------------------------------------------------------*/

typedef struct
{
  signed char  t;  //  -128C ~ 127C
  unsigned long r; //  1 ohm/bit
}
temp_node_t;

typedef struct
{
  char * name;
  temp_node_t * curve;
  unsigned char length;
}
temp_curve_t;

/* Private consts ------------------------------------------------------------*/

//  CWF4-103F-4150F/��6-L1000
const temp_node_t temp_curve_cwf4[] = 
{
  { -55,1104010 },
  { -54,1026770 },
  { -53,955265 },
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  { 125,285 },
};

//  epcos
const temp_node_t temp_curve_epcos[] = {
//	T		R	
{ -40,188500 },
{ -39,178500 },
{ -38,169000 },
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{ 110,757.6 },
};

//  muRata NXFT15XH103
const temp_node_t temp_curve_muRata[] = {
//	T		R	
{	-40	,	197388	},
{	-35	,	149395	},
{	-30	,	114345	},
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{	125	,	532	},
};


const temp_curve_t temp_curve[NTC_CURVE_MAX] = 
{
  {
    "CWF4-103F-4150F/��6-L1000",
    (temp_node_t*)temp_curve_cwf4,
    sizeof(temp_curve_cwf4)/sizeof(temp_node_t),
  },
  {
    "EPCOS",
    (temp_node_t*)temp_curve_epcos,
    sizeof(temp_curve_epcos)/sizeof(temp_node_t),
  },
  {
    "MURATA-NXFT15XH103",
    (temp_node_t*)temp_curve_muRata,
    sizeof(temp_curve_muRata)/sizeof(temp_node_t),
  },
};


/* Private variables ---------------------------------------------------------*/

/* Private function prototypes -----------------------------------------------*/

/* Global consts -------------------------------------------------------------*/

/* Global variables ----------------------------------------------------------*/

/* Functions -----------------------------------------------------------------*/

/**
  * bref    NTC function
  * param   none
  * retval  none
  */

static unsigned char ntc_search(unsigned long res, temp_node_t * curve, unsigned char length)
{
  unsigned char a, b;
  unsigned short c;
  
  a = 0;
  b = length-1;

  NTC_PRINTF("NTC: ");

  if( res > curve[a].r ) return a;
  if( res < curve[b].r ) return b;

  for(;;){

//    DBG_PRINTF("%d|%d,",a,b);
    NTC_PRINTF("%d|%d,",a,b);

    if( a+1==b ) return a;
    c = (a+b+1)/2;
    if( res > curve[c].r ){ b = (unsigned char)c; continue; }
    if( res < curve[c].r ){ a = (unsigned char)c; continue; }
    return (unsigned char)c;

  }  

}

static signed short ntc_insert(unsigned long res, temp_node_t * curve, unsigned char pos, unsigned char length)
{

  signed short ta, tb;
  signed long  ra, rb;
  signed long  tmp1, tmp2;
  
  if( pos>length-1 ){
    PWARNO(WARNO_INDEX_OVERFLOW,pos);
    pos = length-1;
  }
  ta = curve[pos].t * 10;
  if( pos==length-1 ) return ta;
  if( pos==0 && res>curve[pos].r ) return ta;
  
  ra = curve[pos].r;
  tb = curve[pos+1].t * 10;
  rb = curve[pos+1].r;

  /*
    ta - tb    T - tb     ta - T               ta(R-rb) + tb(ra-R)
    ------- = -------- = --------  ====>   T = -------------------
    ra - rb    R - rb     ra - R                     ra - rb
  */
  tmp1 = res - rb;
  tmp1 *= ta;
  tmp2 = ra - res;
  tmp2 *= tb;
  tmp1 = tmp1 + tmp2;
  tmp2 = ra - rb;
  if( tmp2==0 ){
    PERRNO(ERRNO_DIVIDE_ZERO,0);
    return -2730;
  }
  tmp1 = tmp1+(tmp2+1)/2;
  tmp1 /= tmp2;  
  if( tmp1>0xFFFF ){
    PERRNO(ERRNO_CALC_OVERFLOW,(int)(tmp1>>16));
    return -2730;
  }

  return (signed short)tmp1;

}

signed short ntc_res_to_temp(unsigned long res, unsigned char type)
{

  temp_node_t *  curve;
  unsigned char  length;
  unsigned char  pos;
  signed short   temp;
  

  if( type>=NTC_CURVE_MAX ){
    PERRNO(ERRNO_INVALID_PARAMETERS,type);
    return  -2730;
  }

  curve = temp_curve[type].curve;
  length = temp_curve[type].length;
//  DBG_PRINTF("ntc search\n");
  pos = ntc_search(res,curve,length);
  
  NTC_PRINTF(">> %dC @ %d, ", curve[pos].t, pos);
  
//  DBG_PRINTF("ntc insert\n");
  temp = ntc_insert(res,curve,pos,length);
  NTC_PRINTF(">> %d, ", (int)temp);

  return temp;

}

